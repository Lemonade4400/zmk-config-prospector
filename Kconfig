## Kconfig
```kconfig
config GPIO_BACKLIGHT_TEST
	bool "GPIO backlight test - toggles P1.11 to test backlight"
	default n
	depends on GPIO
```

## boards/shields/display_test/Kconfig.defconfig
```kconfig
if SHIELD_DISPLAY_TEST

config ZMK_KEYBOARD_NAME
    default "DispTest"

config ZMK_USB
    default y

config GPIO
    default y

config DISPLAY_HW_TEST
    default y

# Disable display stack (we do raw GPIO)
config ZMK_DISPLAY
    default n

config ZMK_SPLIT
    default n

# Keep BLE enabled to avoid ZMK build issues on nRF52
config ZMK_BLE
    default y

endif
```

## config/west.yml
```yaml
manifest:
  remotes:
    - name: zmkfirmware
      url-base: https://github.com/zmkfirmware
    - name: t-ogura
      url-base: https://github.com/t-ogura
  projects:
    - name: zmk
      remote: zmkfirmware
      revision: v0.2
      import: app/west.yml
    - name: prospector-zmk-module
      remote: t-ogura
      revision: v2.0.0
      path: modules/prospector-zmk-module
  self:
    path: config
```

## gpio-backlight-test/Kconfig
```kconfig
config GPIO_BACKLIGHT_TEST
	bool "GPIO backlight test - toggles P1.11 to test backlight"
	default y
	depends on GPIO
```
